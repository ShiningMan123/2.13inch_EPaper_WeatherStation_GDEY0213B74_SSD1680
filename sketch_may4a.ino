
/*This project is developed based on arduinoIDE, and the libraries used are: Adafruit-GFX, ArduinoJson, GxEPD, please install the above related libraries.*/


#include <GxEPD.h>
#include "SD.h"
 #include <WiFi.h> 
#include <HTTPClient.h> 
#include <ArduinoJson.h> 


//#include <GxGDE0213B1/GxGDE0213B1.h>      // 2.13" b/w
//#include <GxGDEH0213B72/GxGDEH0213B72.h>  // 2.13" b/w new panel
//#include <GxGDEH0213B73/GxGDEH0213B73.h>  // 2.13" b/w newer panel
#include "GxGDEM0213B74/GxGDEM0213B74.h"
String now_address="",now_weather="",now_temperature="";//用来存储报文得到的字符串 Used to store the string obtained by the message
const char* ssid = "6666"; // 你的WiFi账号 Plz enter your own WIFI
const char* password = "88888888"; // 你的WIFI密码 Your own passowrd
   HTTPClient http;  //开始登陆  login
void get_WIFI(){
Serial.begin(115200);
   WiFi.begin(ssid, password);
   while (WiFi.status() != WL_CONNECTED) { //等待wifi连接 waiting for WiFi connection
    delay(500);
    Serial.print(".."); //重复打印 "Connecting.."，直到连接成功 till WiFi connected
    }
    Serial.println(" ");
     Serial.println("Connected to ");
     Serial.println(ssid);
     Serial.println("IP address: ");
     Serial.println(WiFi.localIP());
     }
void get_weather(){
  if (WiFi.status() == WL_CONNECTED) { //如果 Wi-Fi 连接成功
    //此处往下是取得实况天气的程序

 
   //心知API的网址，记得修改自己的密码！！！！！！！ Seniverse API Plz remember to change the password
   http.begin("https://api.seniverse.com/v3/weather/now.json?key=SkUsKfvvlcFrF4ezk&location=WWYMRT0VRMUG&language=zh-Hans&unit=c");
    
    int httpget_now = http.GET(); //赋值 Assign value
      Serial.println("httpget_now:");
    Serial.println(httpget_now);
    if (httpget_now == HTTP_CODE_OK) { //检查一下是否为0，应该是去检查缓存区是否为空 Check whether it is 0, it should be to check whether the buffer area is empty
      Serial.println("that is ok");
     String respone =  http.getString();
      Serial.println(respone);
        /*数据解析:使用 https://arduinojson.org/assistant/ 一个工具可以直接生成程序，挑有用的复制就行  Data analysis: use https://arduinojson.org/assistant/ A tool can directly generate programs, just pick useful copies*/
 const size_t capacity = JSON_ARRAY_SIZE(1) + JSON_OBJECT_SIZE(1) + 2*JSON_OBJECT_SIZE(3) + JSON_OBJECT_SIZE(6) + 210;
DynamicJsonBuffer doc(capacity);
            
        JsonObject& root = doc.parseObject(respone);

        JsonObject& results_0 = root["results"][0];
     
JsonObject& results_0_location = results_0["location"];
const char* results_0_location_id = results_0_location["id"]; // "WM6N2PM3WY2K"
const char* results_0_location_name = results_0_location["name"]; // "成都"
const char* results_0_location_country = results_0_location["country"]; // "CN"
const char* results_0_location_path = results_0_location["path"]; // "成都,成都,四川,中国"
const char* results_0_location_timezone = results_0_location["timezone"]; // "Asia/Shanghai"
const char* results_0_location_timezone_offset = results_0_location["timezone_offset"]; // "+08:00"

JsonObject& results_0_now = results_0["now"];
const char* results_0_now_text = results_0_now["text"]; // "多云"
const char* results_0_now_code = results_0_now["code"]; // "4"
const char* results_0_now_temperature = results_0_now["temperature"]; // "9"

const char* results_0_last_update = results_0["last_update"]; // "2023-5-05T11:30:00+08:00"
   
        //赋值，因为现在这些变量是在缓存区，一会将被清空
         now_address=results_0_location_name;   //北京
         now_weather=results_0_now_text;    //晴
         now_temperature=results_0_now_temperature;    //19
        http.end();
        delay(100);
        }   
  }
    }

int bmpWidth = 250, bmpHeight = 122;
int qingWidth= 96, qingHeight = 59;
int duoyunWidth= 96, duoyunHeight = 59;
int yinWidth= 96, yinHeight = 59;
int zhenyuWidth= 96, zhenyuHeight = 64;
int xiaoyuWidth= 96, xiaoyuHeight = 64;
int fhWidth= 24, fhHeight = 19;
int tipsWidth= 200, tipsHeight = 23;
const unsigned char address[] = {0x00,0x00,0x00,0x00,0x00,0x00,0x00,0x00,0x00,0x00,0x00,0x00,0x00,0x00,0x00,0x00,
0x00,0x00,0x00,0x00,0x00,0x00,0x00,0x00,0x00,0x00,0x00,0x00,0x00,0x00,0x00,0x00,
0x00,0x00,0x00,0x00,0x00,0x00,0x00,0x00,0x00,0x00,0x00,0x00,0x00,0x00,0x00,0x00,
0x00,0x00,0x00,0x00,0x00,0x00,0x00,0x00,0x00,0x00,0x00,0x00,0x00,0x00,0x00,0x00,
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0x00,0x00,0x00,0x00,0x00,0x00,0x00,0x00,0x00,0x00,0x00,0x00,0x00,0x00,0x00,0x00

};
const unsigned char qing[] = {0x00,0x00,0x00,0x00,0x00,0x00,0x00,0x00,0x00,0x00,0x00,0x00,0x00,0x00,0x00,0x00,
0x00,0x00,0x00,0x00,0x00,0x00,0x00,0x00,0x00,0x00,0x00,0x00,0x00,0x00,0x00,0x00,
0x00,0x00,0x00,0x00,0x00,0x00,0x00,0x00,0x00,0x00,0x00,0x00,0x00,0x00,0x00,0x00,
0x00,0x00,0x00,0x00,0x00,0x00,0x00,0x00,0x00,0x00,0x00,0x00,0x00,0x00,0x00,0x01,
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0x00,0x00,0x00,0x00};
const unsigned char duoyun[] = {0x00,0x00,0x00,0x00,0x00,0x00,0x00,0x00,0x00,0x00,0x00,0x00,0x00,0x00,0x00,0x00,
0x00,0x00,0x00,0x00,0x00,0x00,0x00,0x00,0x00,0x00,0x00,0x00,0x00,0x00,0x00,0x00,
0x00,0x00,0x00,0x00,0x00,0x00,0x00,0x00,0x00,0x00,0x00,0x00,0x00,0x00,0x00,0x00,
0x00,0x00,0x00,0x00,0x00,0x08,0x00,0x00,0x00,0x00,0x00,0x00,0x00,0x00,0x00,0x00,
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0x00,0x00,0x00,0x00};
const unsigned char yin[] = {0x00,0x00,0x00,0x00,0x00,0x00,0x00,0x00,0x00,0x00,0x00,0x00,0x00,0x00,0x00,0x00,
0x00,0x00,0x00,0x00,0x00,0x00,0x00,0x00,0x00,0x00,0x00,0x00,0x00,0x00,0x00,0x00,
0x00,0x00,0x00,0x00,0x00,0x00,0x00,0x00,0x00,0x00,0x00,0x00,0x00,0x00,0x00,0x00,
0x00,0x00,0x00,0x00,0x00,0x00,0x00,0x00,0x00,0x00,0x00,0x00,0x00,0x00,0x00,0x00,
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0x00,0x00,0x00,0x00};
const unsigned char fh[] = {0x00,0x00,0x00,0x78,0x00,0x00,0x6C,0x18,0x00,0x7C,0xFF,0x00,0x79,0xFF,0x80,0x03,
0xC3,0xC0,0x03,0x81,0xC0,0x07,0x00,0x00,0x07,0x00,0x00,0x07,0x00,0x00,0x07,0x00,
0x00,0x07,0x01,0x80,0x07,0x81,0xC0,0x03,0x83,0xC0,0x01,0xE7,0x80,0x00,0xFF,0x00,
0x00,0x3C,0x00,0x00,0x00,0x00,0x00,0x00,0x00};
const unsigned char tips[] = {
0x00,0x00,0x00,0x00,0x00,0x00,0x00,0x00,0x00,0x00,0x00,0x00,0x00,0x00,0x00,0x00,
0x00,0x00,0x00,0x00,0x00,0x00,0x00,0x00,0x00,0x00,0x00,0x00,0x00,0x00,0x04,0x02,
0x00,0x00,0x00,0x00,0x00,0x00,0x00,0x80,0x00,0x00,0x00,0x00,0x00,0x00,0x20,0x00,
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0x00,0x00,0x00,0x00,0x00,0x00,0x00,0x00,0x00,0x00,0x00,0x00,0x00,0x00,0x00};

const unsigned char zhenyu[] = {0x00,0x00,0x02,0x00,0x00,0x00,0x00,0x00,0x00,0x00,0x00,0x00,0x00,0x00,0x46,0x18,
0x00,0x00,0x00,0x00,0x00,0x00,0x00,0x00,0x00,0x00,0xCE,0x70,0x00,0x00,0x00,0x00,
0x00,0x00,0x00,0x00,0x00,0x08,0xCE,0xE0,0x00,0x00,0x00,0x00,0x00,0x00,0x00,0x00,
0x00,0x0C,0xEF,0xE7,0x80,0x00,0x00,0x00,0x00,0x00,0x00,0x00,0x00,0x0C,0xFF,0xFE,
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0x00,0x00,0x00,0x00,0x00,0x00,0x00,0x00,0x00,0x00,0x00,0x00,0x00,0x00,0x00,0x00};

const unsigned char xiaoyu[] = {0x00,0x00,0x00,0x03,0x00,0x00,0x00,0x00,0x00,0x00,0x00,0x00,0x00,0x00,0x00,0x7F,
0xF8,0x00,0x00,0x00,0x00,0x00,0x00,0x00,0x00,0x00,0x00,0xFF,0xFE,0x00,0x00,0x00,
0x00,0x00,0x00,0x00,0x00,0x00,0x03,0xFF,0xFF,0x00,0x00,0x00,0x01,0x80,0x00,0x00,
0x00,0x00,0x07,0xFF,0xFF,0xC0,0x00,0x00,0x01,0x80,0x00,0x00,0x00,0x00,0x0F,0xFF,
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0x00,0x00,0x00,0x00,0x00,0x00,0x00,0x00,0x1F,0x00,0x00,0x00,0x00,0x00,0x00,0x00};

const unsigned char gImage_1[3904] = { /* 0X00,0X01,0XFA,0X00,0X7A,0X00, */
0X00,0X00,0X00,0X00,0X00,0X00,0X00,0X00,0X00,0X00,0X00,0X00,0X00,0X00,0X00,0X00,
0X00,0X00,0X00,0X00,0X00,0X00,0X00,0X00,0X00,0X00,0X00,0X00,0X00,0X00,0X00,0X00,
0X00,0X00,0X00,0X00,0X00,0X00,0X00,0X00,0X00,0X00,0X00,0X00,0X00,0X00,0X00,0X00,
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0X00,0X00,0X00,0X00,0X00,0X00,0X00,0X00,0X00,0X00,0X00,0X00,0X00,0X00,0X00,0X00,
};













// FreeFonts from Adafruit_GFX
#include <Fonts/FreeMonoBold9pt7b.h>
#include <Fonts/FreeMonoBold12pt7b.h>
#include <Fonts/FreeMonoBold18pt7b.h>
#include <Fonts/FreeMonoBold24pt7b.h>
#include <GxIO/GxIO_SPI/GxIO_SPI.h>
#include <GxIO/GxIO.h>

#define SPI_MOSI 13
#define SPI_MISO -1
#define SPI_CLK 14
#define ELINK_SS 15
#define ELINK_BUSY 1
#define ELINK_RESET 2
#define ELINK_DC 3
//#define SDCARD_SS 13
//#define SDCARD_CLK 14
//#define SDCARD_MOSI 15
//#define SDCARD_MISO 2
//#define BUTTON_PIN 39

GxIO_Class io(SPI, /*CS=5*/ ELINK_SS, /*DC=*/ ELINK_DC, /*RST=*/ ELINK_RESET);
GxEPD_Class display(io, /*RST=*/ ELINK_RESET, /*BUSY=*/ ELINK_BUSY);

//SPIClass sdSPI(VSPI);

bool sdOK = false;
int startX = 0, startY = 0;
int fhstartX = 150, fhstartY = 70;
int tqstartX =130 , tqstartY = 5;
int tipsstartX =10 , tipsstartY = 100;

 char determineqing[]="晴";
 char determineduoyun[]="多云";
 char determineyin[]="阴";
 char determinezhenyu[]="阵雨";
 char determinexiaoyu[]="小雨";
void setup()
{
  get_WIFI();
  Serial.begin(115200);
  Serial.println();
 Serial.println("setup");
  SPI.begin(SPI_CLK, SPI_MISO, SPI_MOSI, ELINK_SS);
  display.init(); // enable diagnostic output on Serial

  display.setRotation(1);
  display.fillScreen(GxEPD_WHITE);
  display.setTextColor(GxEPD_BLACK);
  display.setFont(&FreeMonoBold18pt7b);
  display.setCursor(0, 0);
 // sdSPI.begin(SDCARD_CLK, SDCARD_MISO, SDCARD_MOSI, SDCARD_SS);
  //if (!SD.begin(SDCARD_SS, sdSPI)){
 // sdOK = false;
 // } else {
 // sdOK = true;
 // }
  display.fillScreen(GxEPD_WHITE);
  display.drawBitmap(gImage_1, startX, startY,  bmpWidth, bmpHeight, GxEPD_BLACK);
  display.drawBitmap(fh, fhstartX, fhstartY,  fhWidth, fhHeight, GxEPD_BLACK);
  display.update();
  // goto sleep
  //esp_sleep_enable_ext0_wakeup((gpio_num_t)BUTTON_PIN, LOW);
  //esp_deep_sleep_start();
}
void loop()
{
  get_weather();
    Serial.println("now_address:");
  Serial.println(now_address);
   Serial.println("天气:");
  Serial.println(now_weather);
if(strstr(now_weather.c_str(),determineqing)!=0)
  {
display.drawBitmap(qing, tqstartX, tqstartY,  qingWidth, qingHeight, GxEPD_BLACK);
  }
  if(strstr(now_weather.c_str(),determineduoyun)!=0)
  {
display.drawBitmap(duoyun, tqstartX, tqstartY,  duoyunWidth, duoyunHeight, GxEPD_BLACK);
  }
  if(strstr(now_weather.c_str(),determineyin)!=0)
  {
display.drawBitmap(yin, tqstartX, tqstartY,  yinWidth, yinHeight, GxEPD_BLACK);
  }
  if(strstr(now_weather.c_str(),determinezhenyu)!=0)
  {
display.drawBitmap(zhenyu, tqstartX, tqstartY,  zhenyuWidth, zhenyuHeight, GxEPD_BLACK);
  }
   if(strstr(now_weather.c_str(),determinexiaoyu)!=0)
  {
display.drawBitmap(xiaoyu, tqstartX, tqstartY,  xiaoyuWidth, xiaoyuHeight, GxEPD_BLACK);
  }
     Serial.println("温度:");
  Serial.println(now_temperature);
  display.setCursor(100,90);
  display.println(now_temperature);
// display.drawBitmap(tips, tipsstartX, tipsstartY,  tipsWidth, tipsHeight, GxEPD_BLACK);
  display.update();
  delay(3600000);
}























